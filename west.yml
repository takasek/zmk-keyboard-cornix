## west.yml
```yaml
manifest:
  version: "0.14"
  remotes:
    - name: zmkfirmware
      url-base: https://github.com/zmkfirmware
    - name: wataruw
      url-base: https://github.com/wataruw
  projects:
    - name: zmk
      remote: zmkfirmware
      revision: v0.3.0  # config/west.yml と揃える（Zephyr Main 起因の不具合回避）
      import:
        path-prefix: modules
        file: app/west.yml
    - name: zmk-naginata
      remote: wataruw
      revision: main
  self:
    path: config
```
